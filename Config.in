## Config.in
```kconfig
# make the variant name available as a Config.in variable
#
# you can use BR2SM_PROJECT_NAME to have some options only appear for some variants
#
config BR2SM_PROJECT_NAME
	string
	option env="PROJECT_NAME"
```

## Project1/defconfig
```kconfig
BR2_DL_DIR="$(BR2_EXTERNAL)/dl"
BR2_PACKAGE_OVERRIDE_FILE="$(BR2_EXTERNAL)/$(PROJECT_NAME)/local.mk"
BR2_GLOBAL_PATCH_DIR="$(BR2_EXTERNAL)/$(PROJECT_NAME)/patch"
BR2_ROOTFS_OVERLAY="$(BR2_EXTERNAL)/$(PROJECT_NAME)/overlay"
```
